# hercules_gio_port_a_spec_1.2.1 register map
Vendor: Texas Instruments
Peripheral module from a debugger description file (folder hercules).
Registers are 32-bit, access not given, no defined reset value unless marked. A register's access mark holds for its fields unless they carry their own. Offsets are as the file gives them; lines under a group give offsets from that group; [hi:lo] are bit positions; {n}, {i} and the like mark numbered series; 'fields as' and 'values as' point back to an identical list; <NAME> marks a mode.

## GioA — General Purpose Input Output
0x34 Dir — Data Direction Gio A
0x38 DIn — Data Input Gio A
0x3C DOut — Data Output Gio A
0x40 DSet — Data Set Gio A
0x44 DClr — Data Clear Gio A
0x48 PDr — Open Drain Gio A
0x4C PDis — Pull Disable Gio A
0x50 PSel — Pull Select Gio A
0x134 Srs — Slew Rate Select Gio A

## Notices in the file
(c) Texas Instruments 2003-2012, All rights reserved.
