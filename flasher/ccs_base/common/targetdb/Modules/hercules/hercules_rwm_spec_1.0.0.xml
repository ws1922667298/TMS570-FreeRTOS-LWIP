# hercules_rwm_spec_1.0.0 register map
Vendor: Texas Instruments
Peripheral module from a debugger description file (folder hercules).
Registers are 32-bit, access not given, no defined reset value unless marked. A register's access mark holds for its fields unless they carry their own. Offsets are as the file gives them; lines under a group give offsets from that group; [hi:lo] are bit positions; {n}, {i} and the like mark numbered series; 'fields as' and 'values as' point back to an identical list; <NAME> marks a mode.

## Rwm — RAM Wrapper Module
0x00 Ctrl — Ram Control Register 1
0x04 Threshold
0x08 Occur — Occurrence Register
0x0C IntCtrl — Interrupt Control Register
0x10 ErrStatus — Memory Fault Detect Status Register
0x14 SErrAddr — Single Error Address Register
0x1C UErrAddr — Uncorrectable Error Address Register
0x30 RamTest
0x38 RamAddrDec — RAM Address Decode TEST Register
0x3C RamPErrAddr — Address Parity Error Address Register
0x40 InitDomain — Init Domain Bitmapped Space Register
0x44 BankDomainMap0 — The Lower Half of the Bank_Domain_Mapping
0x48 BankDomainMap1 — The Upper Half of the Bank_Domain_Mapping

## Notices in the file
(c) Texas Instruments 2003-2012, All rights reserved.
