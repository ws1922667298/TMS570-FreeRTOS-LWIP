# hercules_dcan_spec_1.3.2 register map
Vendor: Texas Instruments
Peripheral module from a debugger description file (folder hercules).
Registers are 32-bit, access not given, no defined reset value unless marked. A register's access mark holds for its fields unless they carry their own. Offsets are as the file gives them; lines under a group give offsets from that group; [hi:lo] are bit positions; {n}, {i} and the like mark numbered series; 'fields as' and 'values as' point back to an identical list; <NAME> marks a mode.

## Dcan
0x00 Ctrl — Config register
0x04 ErrStat — Status register
0x08 ErrCnt — Error Counter Register
0x0C Btr — Bit Timing_BRP Extension Register
0x10 IntR — Interrupt Register
0x14 Test
0x1C ParErr — Parity Error Code Register
0x20 Rel — Core Release Register
0x80 AboT — Auto Bus On Time
0x84 TrReqX — Transmission Request X
0x88 TrReq12 — Transmission Request 2-1
0x8C TrReq34 — Transmission Request 4-3
0x90 TrReq56 — Transmission Request 6-5
0x94 TrReq78 — Transmission Request 8-7
0x98 NewDatX — New Data X
0x9C NewDat12 — New Data 2-1
0xA0 NewDat34 — New Data 4-3
0xA4 NewDat56 — New Data 6-5
0xA8 NewDat78 — New Data 8-7
0xAC IntPenX — Interrupt Pending X
0xB0 IntPen12 — Interrupt Pending 2-1
0xB4 IntPen34 — Interrupt Pending 4-3
0xB8 IntPen56 — Interrupt Pending 6-5
0xBC IntPen78 — Interrupt Pending 8-7
0xC0 MsgValX — Message Valid X
0xC4 MsgVal12 — Message Valid 2-1
0xC8 MsgVal34 — Message Valid 4-3
0xCC MsgVal56 — Message Valid 6-5
0xD0 MsgVal78 — Message Valid 8-7
0xD8 IntPndMx12 — IntPndMux 2-1
0xDC IntPndMx34 — IntPndMux 4-3
0xE0 IntPndMx56 — IntPndMux 6-5
0xE4 IntPndMx78 — IntPndMux 8-7
0x100 If1Cmd — If1 Command Mask / Command Request Register
{0xE4+0x20*i} If{i}Msk (i=1..3) — If{i} Mask Register
{0xE8+0x20*i} If{i}Arb (i=1..3) — If{i} Arbitation Register
{0xEC+0x20*i} If{i}MsgCtrl (i=1..3) — If{i} Message Control Register
{0xF0+0x20*i} If{i}DatA (i=1..3) — If{i} Data A Register
{0xF4+0x20*i} If{i}DatB (i=1..3) — If{i} Data B Register
0x120 If2Com — If2 Command Mask / Command Request Register
0x140 If3Obs — If3 Observation Register
0x160 If3Upd12 — Update enable 2-1 Register
0x164 If3Upd34 — Update enable 4-3 Register
0x168 If3Upd56 — Update enable 6-5 Register
0x16C If3Upd78 — Update enable 8-7 Register
0x1E0 IoCtrlTx — TX IO Control Register
0x1E4 IoCtrlRx — RX IO Control Register

## Notices in the file
(c) Texas Instruments 2003-2011, All rights reserved.
