# hercules_gio_port_b_spec_1.2.1 register map
Vendor: Texas Instruments
Peripheral module from a debugger description file (folder hercules).
Registers are 32-bit, access not given, no defined reset value unless marked. A register's access mark holds for its fields unless they carry their own. Offsets are as the file gives them; lines under a group give offsets from that group; [hi:lo] are bit positions; {n}, {i} and the like mark numbered series; 'fields as' and 'values as' point back to an identical list; <NAME> marks a mode.

## GioB — General Purpose Input Output
0x54 Dir — Data Direction Gio B
0x58 DIn — Data Input Gio B
0x5C DOut — Data Output Gio B
0x60 DSet — Data Set Gio B
0x64 DClr — Data Clear Gio B
0x68 PDr — Open Drain Gio B
0x6C PDis — Pull Disable Gio B
0x70 PSel — Pull Select Gio B
0x138 Srs — Slew Rate Select Gio B

## Notices in the file
(c) Texas Instruments 2003-2012, All rights reserved.
