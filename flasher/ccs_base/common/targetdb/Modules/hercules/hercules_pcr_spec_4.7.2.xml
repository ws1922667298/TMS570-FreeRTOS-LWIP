# hercules_pcr_spec_4.7.2 register map
Vendor: Texas Instruments
Peripheral module from a debugger description file (folder hercules).
Registers are 32-bit, access not given, no defined reset value unless marked. A register's access mark holds for its fields unless they carry their own. Offsets are as the file gives them; lines under a group give offsets from that group; [hi:lo] are bit positions; {n}, {i} and the like mark numbered series; 'fields as' and 'values as' point back to an identical list; <NAME> marks a mode.

## Pcr
0x00 PMProtSet0 — Set-only register to Protect PCS frames 0 to 31
0x04 PMProtSet1 — Set-only register to Protect PCS frames 32 to 64
0x10 PMProtClr0 — Clear-only register to Protect PCS frames 0 to 31
0x14 PMProtClr1 — Clear-only register to Protect PCS frames 32 to 64
{0x20+4i} PProtSet{i} (i=0..3) — Set-only register to Protect the 32 quadrants of PS{8i} to PS{8i+7}
{0x40+4i} PProtClr{i} (i=0..3) — clear-only register to Protect the quadrants of PS{8i} to PS{8i+7}
0x60 PCSPwrDwnSet0
0x64 PCSPwrDwnSet1
0x70 PCSPwrDwnClr0
0x74 PCSPwrDwnClr1
{0x80+4i} PSPwrDwnSet{i} (i=0..3)
{0xA0+4i} PSPwrDwnClr{i} (i=0..3)

## Notices in the file
(c) Texas Instruments 2003-2012, All rights reserved.
