# hercules_gio_general_spec_1.2.1 register map
Vendor: Texas Instruments
Peripheral module from a debugger description file (folder hercules).
Registers are 32-bit, access not given, no defined reset value unless marked. A register's access mark holds for its fields unless they carry their own. Offsets are as the file gives them; lines under a group give offsets from that group; [hi:lo] are bit positions; {n}, {i} and the like mark numbered series; 'fields as' and 'values as' point back to an identical list; <NAME> marks a mode.

## Gio — General Purpose Input Output
0x00 GlbCtrl — Global Control Register
0x04 PwDn — Power Down
0x08 IntDet — Interrupt Detect
0x0C IntPol — Interrupt Polarity
0x10 IntEnaSet — Interrupt Enable Set
0x14 IntEnaClr — Interrupt Enable Clear
0x18 IntLvlSet — Interrupt Priority Set
0x1C IntLvlClr — Interrupt Priority Clear
0x20 IntFlg — Interrupt Flag
0x24 OffstA — Offset A
0x28 OffstB — Offset B
0x2C EmuA — Emulation A
0x30 EmuB — Emulation B

## Notices in the file
(c) Texas Instruments 2003-2012, All rights reserved.
