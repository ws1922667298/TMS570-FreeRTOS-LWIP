# hercules_pom_spec_1.8.1 register map
Vendor: Texas Instruments
Peripheral module from a debugger description file (folder hercules).
Registers are 32-bit, access not given, no defined reset value unless marked. A register's access mark holds for its fields unless they carry their own. Offsets are as the file gives them; lines under a group give offsets from that group; [hi:lo] are bit positions; {n}, {i} and the like mark numbered series; 'fields as' and 'values as' point back to an identical list; <NAME> marks a mode.

## Pom — Parameter Overlay Module
0x00 GlbCtrl — Global Control Register
0x04 Rev — Revision Id
0x08 ClkCtrl — Clock Gate Control Register
0x0C Flg — POM Flag Register
{0x200+0x10*i} ProgStart{i} (i=0..31) — Program Region Start Address Register {i}
{0x204+0x10*i} OvlStart{i} (i=0..31) — Overlay Region Start Address Register {i}
{0x208+0x10*i} RegSize{i} (i=0..31) — Region Size Register {i}
0xF00 ItCtrl — Integration Control Register
0xFA0 ClaimSet
0xFA4 ClaimClr — Claim Clear Register
0xFB0 LockAccess
0xFB4 LockStatus
0xFB8 AuthStatus — Authentication Status Register
0xFC8 DevId — Device Id Register
0xFCC DevType — Device Type Register
{0xFC0+4i} PeripheralId{i} (i=4..7)
{0xFE0+4i} PeripheralId{i} (i=0..3)
{0xFF0+4i} ComponentId{i} (i=0..3)

## Notices in the file
(c) Texas Instruments 2003-2012, All rights reserved.
