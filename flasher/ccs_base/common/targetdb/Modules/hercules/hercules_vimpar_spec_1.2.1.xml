# hercules_vimpar_spec_1.2.1 register map
Vendor: Texas Instruments
Peripheral module from a debugger description file (folder hercules).
Registers are 32-bit, access not given, no defined reset value unless marked. A register's access mark holds for its fields unless they carry their own. Offsets are as the file gives them; lines under a group give offsets from that group; [hi:lo] are bit positions; {n}, {i} and the like mark numbered series; 'fields as' and 'values as' point back to an identical list; <NAME> marks a mode.

## VimPar — Vectored Interrupt Manager Parity
0xEC ParFlg — VIM RAM parity Flag register
0xF0 ParCtl — VIM RAM parity control register
0xF4 AddErr — Address Parity Error Register
0xF8 FbParErr — Fall back Address Parity Error Register

## Notices in the file
(c) Texas Instruments 2003-2012, All rights reserved.
