# hercules_pmm_tms570ls3x register map
Vendor: Texas Instruments
Peripheral module from a debugger description file (folder hercules).
Registers are 32-bit, access not given, no defined reset value unless marked. A register's access mark holds for its fields unless they carry their own. Offsets are as the file gives them; lines under a group give offsets from that group; [hi:lo] are bit positions; {n}, {i} and the like mark numbered series; 'fields as' and 'values as' point back to an identical list; <NAME> marks a mode.

## PMM — Power Management Module
{0x0+4i} LogicPDCtrl{i} (i=0..3) — Logic Power Domain Control Register
0x10 MemPDCtrl0 — Memory Power Domain Control Register
0x14 MemPDCtrl1 — Memory Power Domain Control Register
0x20 PDClkDis — Power Domain Clock Disable Register
0x24 PDClkDisSet — Power Domain Clock Disable SET Register
0x28 PDClkDisClr — Power Domain Clock Disable CLEAR Register
0x30 IsoExtend — Isolation Extension Register
0x34 IsoExtendSet — Isolation Extension SET Register
0x38 IsoExtendClr — Isolation Extension CLEAR Register
{0x40+4i} LogicPDPwrStat{i} (i=0..15) — Logic Power Domain Power Status
{0x80+4i} MemPwrStat{i} (i=0..7) — Memory Power Domain Power Status
0xA0 GlobalCtrl1 — Global Control Register1
0xA4 GlobalCtrl2 — Global Control Register2
0xA8 GlobalStatus
0xAC PsconDiagCompKey — PSCON Diagnostic Compare Key Register
0xB0 PsconDiagCompStat1 — LogicPD PSCON Diagnostic Compare Status Register1
0xB4 PsconDiagCompStat2 — LogicPD PSCON Diagnostic Compare Status Register2
0xB8 MPDDiaCompStat1 — Memory PD PSCON Diagnostic Compare Status Register1
0xBC MPDDiaCompStat2 — Memory PD PSCON Diagnostic Compare Status Register2
0xC0 IsoDiaStat — Isolation Diagnostic Status

## Notices in the file
(c) Texas Instruments 2003-2012, All rights reserved.
