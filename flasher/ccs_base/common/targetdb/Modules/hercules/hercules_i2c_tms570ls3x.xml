# hercules_i2c_tms570ls3x register map
Vendor: Texas Instruments
Peripheral module from a debugger description file (folder hercules).
Registers are 32-bit, access not given, no defined reset value unless marked. A register's access mark holds for its fields unless they carry their own. Offsets are as the file gives them; lines under a group give offsets from that group; [hi:lo] are bit positions; {n}, {i} and the like mark numbered series; 'fields as' and 'values as' point back to an identical list; <NAME> marks a mode.

## I2C — I2C Module
0x00 I2COAR — I2C Own Address Manager
0x04 I2CIMR — I2C Interrupt Mask Register
0x08 I2CSTR — I2C Status Register
0x0C I2CCKL — I2C Clock Divider Low Register
0x10 I2CCKH — I2C Clock Control High Register
0x14 I2CCNT — I2C Data Count Register
0x18 I2CDRR — I2C Data Receive Register
0x1C I2CSAR — I2C Slave Address Register
0x20 I2CDXR — I2C Data Transmit Register
0x24 I2CMDR — I2C Mode Register
0x28 I2CIVR — I2C Interrupt Vector Register
0x2C I2CEMDR — I2C Extended Mode Register
0x30 I2CPSC — I2C Prescale Register
0x34 I2CPID1 — I2C Peripheral ID Register 1
0x38 I2CPID2 — I2C Peripheral ID Register 2
0x3C I2CDMACR — I2C DMA Control Register
0x48 I2CPFNC — I2C Pin Function Register
0x4C I2CPDIR — I2C Pin Direction Register
0x50 I2CDIN — I2C Data Input Register
0x54 I2CDOUT — I2C Data Output Register
0x58 I2CDSET — I2C Data Set Register
0x5C I2CDCLR — I2C Data Clear Register
0x60 I2CPDR — I2C Pin Open Drain Register
0x64 I2CPDIS — I2C Pull Disable Register
0x68 I2CPSEL — I2C Pull Select Register
0x6C I2CSRS — I2C Pins Slew Rate Select Register

## Notices in the file
(c) Texas Instruments 2003-2012, All rights reserved.
