# hercules_sys_spec_4.7.2 register map
Vendor: Texas Instruments
Peripheral module from a debugger description file (folder hercules).
Registers are 32-bit, access not given, no defined reset value unless marked. A register's access mark holds for its fields unless they carry their own. Offsets are as the file gives them; lines under a group give offsets from that group; [hi:lo] are bit positions; {n}, {i} and the like mark numbered series; 'fields as' and 'values as' point back to an identical list; <NAME> marks a mode.

## Sys — System Modules
0x00 SysPc1 — Sys Pin Control Register 1
0x04 SysPc2 — Sys Pin Control Register 2
0x08 SysPc3 — Sys Pin Control Register 3
0x0C SysPc4 — Sys Pin Control Register 4
0x10 SysPc5 — Sys Pin Control Register 5
0x14 SysPc6 — Sys Pin Control Register 6
0x18 SysPc7 — Sys Pin Control Register 7
0x1C SysPc8 — Sys Pin Control Register 8
0x20 SysPc9 — Sys Pin Control Register 9
0x30 CsDis — Clock Source Disable Register
0x34 CsDisSet — Clock Source Disable Set Register
0x38 CsDisClr — Clock Source Disable Clear Register
0x3C CdDis — Clock Domain Disable Register
0x40 CdDisSet — Clock Domain Disable Set Register
0x44 CdDisClr — Clock Domain Disable Clear Register
0x48 GhvSrc — GClk, HClk, VClk, and VClk2 Source Register
0x4C VlckASrc — Peripheral Asynchronous Clock Source Register
0x50 RclkSrc — RTI Clock Source Register
0x54 CsVStat — Clock Source Valid Status Register
0x58 MstGlbCtrl — Memory Self-Test Global Control Register
0x5C MinitGlbCtrl — Memory Hardware Initialization Global Control Register
0x60 MsInEna — MBIST Controller/Memory Initialization Enable Register
0x64 MstFail — Memory Self-Test Fail Status Register
0x68 MstCgStat — MstC Global Status Register
0x6C MIniStat — Memory Hardware Initialization Status Register
0x70 PllCtl1 — Pll Control Register 1
0x74 PllCtl2 — Pll Control Register 2
0x78 SysPc10 — Sys Pin Control Register 10
0x7C DieIdL — Die Identification Register, Lower Word
0x80 DieIdH — Die Identification Register Upper Word
0x88 LpoMonCtl — Lpo/Clock Monitor Control Register
0x8C ClkTest — Clock Test Register
0x90 DftCtrlReg — DFT Control Register
0x94 DftCtrlReg2 — DFT Control Register 2
0xA0 GPREG1 — General Purpose Register
0xA8 ImpFaSts — Imprecise Fault Status Register
0xAC ImpFtAdd — Imprecise Fault Write Address Register
{0xAC+4i} SSIr{i} (i=1..4) — System Software Interrupt Request {i} Register
0xC0 RamGlbCtrl — Ram Control Register
0xC4 BmmCr1 — Bus Matrix Module Control Register1
0xC8 BmmCr2 — Bus Matrix Module Control Register2
0xCC MmuGlbCtrl — Mmu Global Control Register
0xD0 ClkCntl — Clock Control Register
0xD4 EcpCntl — ECP Control Register
0xDC DevCr1 — DEV Parity Control Register1
0xE0 SysEcr — System Exception Control Register
0xE4 SysEsr — System Exception Status Register
0xE8 SysTasr — System Test Abort Status Register
0xEC GlbStat — Global Status Register
0xF0 DevId — Device Identification Register
0xF4 SSiVec — Software Interrupt Vector Register
0xF8 SSIf — System Software Interrupt Flag Register

## Notices in the file
(c) Texas Instruments 2003-2012, All rights reserved.
