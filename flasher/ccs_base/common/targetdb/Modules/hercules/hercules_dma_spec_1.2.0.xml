# hercules_dma_spec_1.2.0 register map
Vendor: Texas Instruments
Peripheral module from a debugger description file (folder hercules).
Registers are 32-bit, access not given, no defined reset value unless marked. A register's access mark holds for its fields unless they carry their own. Offsets are as the file gives them; lines under a group give offsets from that group; [hi:lo] are bit positions; {n}, {i} and the like mark numbered series; 'fields as' and 'values as' point back to an identical list; <NAME> marks a mode.

## Dma — Direct Memory Access
0x00 GlbCtrl — Global Control Register
0x04 ChnPnd — Channel Pending Register
0x0C Stat — Status Register
0x14 HWChnEnaSet — H/W Channel Enable Set and Status Register
0x1C HWChnEnaRst — H/W Channel Enable Reset and Status Register
0x24 SWChnEnaSet — S/W Channel Enable Set and Status Register
0x2C SWChnEnaRst — S/W Channel Enable Reset and Status Register
0x34 ChnPrioSet — Channel Priority Set Register
0x3C ChnPrioRst — Channel Priority Reset
0x44 GlbChnIntEnaSet — Global Channel Interrupt Enable Set
0x4C GlbChnIntEnaRst — Global Channel Interrupt Enable Reset
{0x54+4i} ReqAssg{i} (i=0..7) — Request Assignment Register {i}
{0x94+4i} PrtAssg{i} (i=0..3) — Port Assignment Register {i}
0xB4 FTCMap — FTC Interrupt Mapping Register
0xBC LFSMap — LFS Interrupt Mapping Register
0xC4 HBCMap — HBC Interrupt Mapping Register
0xCC BTCMap — BTC Interrupt Mapping Register
0xD4 BERMap — BER Interrupt Mapping Register
0xDC FTCIntEnaSet — FTC Interrupt Enable Set
0xE4 FTCIntEnaRst — FTC Interrupt Enable Reset
0xEC LFSIntEnaSet — LFS Interrupt Enable Set
0xF4 LFSIntEnaRst — LFS Interrupt Enable Reset
0xFC HBCIntEnaSet — HBC Interrupt Enable Set
0x104 HBCIntEnaRst — HBC Interrupt Enable Reset
0x10C BTCIntEnaSet — BTC Interrupt Enable Set
0x114 BTCIntEnaRst — BTC Interrupt Enable Reset
0x11C GlbIntFlg — Global Interrupt Flg Register
0x124 FTCIntFlg — FTC Interrupt Flag Register
0x12C LFSIntFlg — LFS Interrupt Flag Register
0x134 HBCIntFlg — HBC Interrupt Flag Register
0x13C BTCIntFlg — BER Interrupt Flag Register
0x144 BERIntFlg — BER Interrupt Flag Register
0x14C FTCAOffst — FTCA Interrupt Channel Offset Register
0x150 LFSAOffst — LFSA Interrupt Channel Offset Register
0x154 HBCAOffst — HBCA Interrupt Channel Offset Register
0x158 BTCAOffst — BTCA Interrupt Channel Offset Register
0x15C BERAOffst — BERA Interrupt Channel Offset Register
0x160 FTCBOffst — FTCB Interrupt Channel Offset Register
0x164 LSFBOffst — LFSB Interrupt Channel Offset Register
0x168 HBCBOffst — HBCB Interrupt Channel Offset Register
0x16C BTCBOffst — BTCB Interrupt Channel Offset Register
0x170 BERBOffst — BERB Interrupt Channel Offset Register
0x178 PrtCtrl — Port Control Register
0x17C RamTstCtrl — RAM TEST Control
0x180 DbgCtrl — Debug Control
0x184 WpReg — Watchpoint Register
0x188 WpMsk — Watchpoint Mask Register
0x18C PrtAChnSrcAddr — Port A Active Channel Source Address Register
0x190 PrtAChnDstAddr — Port A Active Channel Destination Address Register
0x194 PrtAChnTrCnt — Port A Active Channel Transfer Count Register
0x198 PrtBChnSrcAddr — Port B Active Channel Source Address Register
0x19C PrtBChnDestAddr — Port B Active Channel Destination Address Register
0x1A0 PrtBChnTrCnt — Port B Active Channel Transfer Count Register
0x1A8 ParCtrl — Parity Control Register
0x1AC ParErrAddr — Parity Error Address Register
0x1B0 MpCtrl — Memory Protection Control Register
0x1B4 MpStat — Memory Protection Status Register
0x1B8 Pr0Strt — Start Address of region 0
{0x1BC+8i} Pr{i}End (i=0..3) — End Address of region {i}
0x1C0 Pr1Strt — Start Address of region 0
0x1C8 Pr2Strt — Start Address of region 2
0x1D0 Pr3Strt — Start Address of region 3

## Notices in the file
(c) Texas Instruments 2003-2012, All rights reserved.
